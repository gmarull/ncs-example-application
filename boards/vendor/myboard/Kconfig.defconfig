## boards/vendor/myboard/Kconfig.defconfig
```kconfig
if BOARD_MYBOARD_NRF54L15_CPUAPP

config BT_CTLR
	default BT

config ROM_START_OFFSET
	default 0 if PARTITION_MANAGER_ENABLED
	default 0x800 if BOOTLOADER_MCUBOOT

endif # BOARD_MYBOARD_NRF54L15_CPUAPP
```

## boards/vendor/myboard/Kconfig.myboard
```kconfig
config BOARD_MYBOARD
	select SOC_NRF54L15_CPUAPP if BOARD_MYBOARD_NRF54L15_CPUAPP
```

## boards/vendor/myboard/board.yml
```yaml
board:
  name: myboard
  full_name: My Board
  vendor: custom
  socs:
  - name: nrf54l15
```
